## sdkconfig.defaults
```kconfig
# ESP32 Small OS Configuration Defaults
# This file contains default configuration for ESP32 Small OS

# WiFi Configuration
CONFIG_ESP32_WIFI_ENABLED=y
CONFIG_ESP32_WIFI_SW_COEXIST_ENABLE=y
CONFIG_ESP32_WIFI_STATIC_RX_BUFFER_NUM=10
CONFIG_ESP32_WIFI_DYNAMIC_RX_BUFFER_NUM=32
CONFIG_ESP32_WIFI_TX_BUFFER_TYPE=1
CONFIG_ESP32_WIFI_DYNAMIC_TX_BUFFER_NUM=32
CONFIG_ESP32_WIFI_AMPDU_TX_ENABLED=y
CONFIG_ESP32_WIFI_AMPDU_RX_ENABLED=y

# Network Configuration
CONFIG_LWIP_TCPIP_RECVMBOX_SIZE=32
CONFIG_LWIP_UDP_RECVMBOX_SIZE=6
CONFIG_LWIP_TCP_RECVMBOX_SIZE=6
CONFIG_LWIP_TCP_WND=6144
CONFIG_LWIP_TCP_SND_BUF=8192
CONFIG_LWIP_TCP_MSS=1440
CONFIG_LWIP_NETIF_TX_SINGLE_PBUF=y
CONFIG_LWIP_NETIF_STATUS_CALLBACK=y
CONFIG_LWIP_MAX_SOCKETS=10

# Memory Configuration
CONFIG_ESP32_TRACEMEM_RESERVE_DRAM=0x0
CONFIG_ESP32_ULP_COPROC_RESERVE_MEM=0
CONFIG_ESP32_PANIC_PRINT_REBOOT=y
CONFIG_ESP32_DEBUG_OCDAWARE=y
CONFIG_ESP32_BROWNOUT_DET=y
CONFIG_ESP32_BROWNOUT_DET_CFG_SEL_0=y

# FreeRTOS Configuration
CONFIG_FREERTOS_HZ=1000
CONFIG_FREERTOS_CHECK_STACKOVERFLOW_NONE=y
CONFIG_FREERTOS_THREAD_LOCAL_STORAGE_POINTERS=1
CONFIG_FREERTOS_IDLE_TASK_STACKSIZE=2048
CONFIG_FREERTOS_TIMER_TASK_PRIORITY=1
CONFIG_FREERTOS_TIMER_TASK_STACK_DEPTH=2048

# Logging Configuration
CONFIG_LOG_DEFAULT_LEVEL_INFO=y
CONFIG_LOG_MAXIMUM_LEVEL=3
CONFIG_LOG_MAXIMUM_LEVEL_DEFAULT=3
CONFIG_LOG_TIMESTAMP_SOURCE_RTOS=y
CONFIG_LOG_COLORS=y

# Component Configuration
CONFIG_ESP_TIMER_IMPL_FRC2=y
CONFIG_ESP_TIMER_TASK_STACK_SIZE=2048
CONFIG_ESP_TIMER_TASK_PRIO=1
CONFIG_ESP_TIMER_ALLOW_INTERRUPT=y

# ESP32 Specific
CONFIG_ESP32_DEFAULT_CPU_FREQ_240=y
CONFIG_ESP32_DEFAULT_CPU_FREQ_MHZ=240
CONFIG_ESP32_XTAL_FREQ_40=y
CONFIG_ESP32_XTAL_FREQ=40

# Bootloader Configuration
CONFIG_BOOTLOADER_COMPILER_OPTIMIZATION_SIZE=y
CONFIG_BOOTLOADER_LOG_LEVEL_INFO=y
CONFIG_BOOTLOADER_VDDSDIO_BOOST_1_8V=y

# Partition Table
CONFIG_PARTITION_TABLE_SINGLE_APP=y
CONFIG_PARTITION_TABLE_CUSTOM_FILENAME="partitions.csv"
CONFIG_PARTITION_TABLE_FILENAME="partitions.csv"
CONFIG_PARTITION_TABLE_OFFSET=0x8000

# NVS Configuration
CONFIG_NVS_ENCRYPTION=y
CONFIG_NVS_DEFAULT_PART_NAME="nvs"
CONFIG_NVS_DATA_PART_NAME="nvs"
CONFIG_NVS_DATA_PART_SIZE=0x6000

# SPI Flash Configuration
CONFIG_SPI_FLASH_ROM_DRIVER_PATCH=y
CONFIG_SPI_FLASH_ENABLE_ENCRYPTED_READ_WRITE=y
CONFIG_SPI_FLASH_USE_LEGACY_IMPL=y
CONFIG_SPI_FLASH_SIZE_4MB=y
CONFIG_SPI_FLASH_SIZE=4MB

# SPI RAM Configuration
CONFIG_SPIRAM=y
CONFIG_SPIRAM_SPEED_40M=y
CONFIG_SPIRAM_USE_MALLOC=y
CONFIG_SPIRAM_USE_CAPS_ALLOC=y
CONFIG_SPIRAM_USE_HEAP=y
CONFIG_SPIRAM_MEMTEST=y

# Performance Monitoring
CONFIG_PERFORMANCE_MONITOR=y
CONFIG_PERFORMANCE_MONITOR_PRINT_INTERVAL=10

# Power Management
CONFIG_PM_ENABLE=y
CONFIG_PM_POWER_SAVE_MODE=y
CONFIG_PM_SLEEP_DEFAULT=y

# ADC Configuration
CONFIG_ADC_CAL_EFUSE_TP_ENABLE=y
CONFIG_ADC_CAL_EFUSE_VREF_ENABLE=y
CONFIG_ADC_CAL_LUT_ENABLE=y
CONFIG_ADC_CAL_LUT_VREF_ENABLE=y

# DAC Configuration
CONFIG_DAC_ENABLE=y

# LEDC Configuration
CONFIG_LEDC_ENABLE=y
CONFIG_LEDC_CTRL_SPEED_HIGH_SPEED_MODE=y

# I2C Configuration
CONFIG_I2C_ENABLE=y
CONFIG_I2C_NUM_PORTS=2

# SPI Configuration
CONFIG_SPI_MASTER_IN_IRAM=y
CONFIG_SPI_SLAVE_IN_IRAM=y

# UART Configuration
CONFIG_UART_ISR_IN_IRAM=y
CONFIG_UART_CONSOLE_UART_NUM=0

# GPIO Configuration
CONFIG_GPIO_CTRL_FUNC_IN_IRAM=y

# Timer Configuration
CONFIG_TIMER_ISR_IN_IRAM=y
CONFIG_TIMER_GROUP_ENABLE=y

# Watchdog Configuration
CONFIG_ESP_TASK_WDT=y
CONFIG_ESP_TASK_WDT_TIMEOUT_S=5
CONFIG_ESP_INT_WDT=y
CONFIG_ESP_INT_WDT_TIMEOUT_MS=300

# Event Loop Configuration
CONFIG_ESP_EVENT_LOOP_PROFILING=y

# HTTP Server Configuration
CONFIG_HTTPD_WS_SUPPORT=y
CONFIG_HTTPD_MAX_REQ_HDR_LEN=512
CONFIG_HTTPD_MAX_URI_LEN=512
CONFIG_HTTPD_ERR_RESP_NO_DELAY=y

# mbedTLS Configuration
CONFIG_MBEDTLS_SSL_MAX_CONTENT_LEN=4096
CONFIG_MBEDTLS_ASYMMETRIC_CONTENT_LEN=4096
CONFIG_MBEDTLS_HARDWARE_AES=y
CONFIG_MBEDTLS_HARDWARE_SHA=y

# JSON Configuration
CONFIG_JSON_ENABLE=y

# File System Configuration
CONFIG_SPIFFS_MAX_FILES=5
CONFIG_SPIFFS_CACHE=1
CONFIG_FATFS_LFN=y
CONFIG_FATFS_FS_NORTC=y
CONFIG_FATFS_CODEPAGE_437=y
CONFIG_FATFS_MAX_LFN=255

# Debug Configuration
CONFIG_ESP32_DEBUG_STUBS_ENABLE=y
CONFIG_ESP32_DEBUG_OCDAWARE=y
CONFIG_ESP32_BROWNOUT_DET=y
```
